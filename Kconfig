## Kconfig
```kconfig
menu "ZMK Input Notifier (pointer + encoder over Raw HID)"

config ZMK_INPUT_NOTIFIER
    bool "Enable Raw HID notifier for pointer deltas and encoder ticks"
    depends on !ZMK_SPLIT || ZMK_SPLIT_ROLE_CENTRAL
    default y if !ZMK_SPLIT || ZMK_SPLIT_ROLE_CENTRAL
    select RAW_HID
    help
      Hooks each pixart,pmw3610 input device and the ZMK sensor event
      bus to stream live pointer deltas (marker 0xF2) and encoder ticks
      (marker 0xF3) over the existing 32-byte Raw HID interface.

endmenu
```
